## split-ortho4x6-akdk (1)/boards/shields/split_ortho4x6/Kconfig.defconfig
```kconfig
if SHIELD_SPLIT_ORTHO4X6_LEFT

config ZMK_KEYBOARD_NAME
    default "split_ortho4x6"

endif

if SHIELD_SPLIT_ORTHO4X6_LEFT || SHIELD_SPLIT_ORTHO4X6_RIGHT

config ZMK_SPLIT
    default y

endif
```

## split-ortho4x6-akdk (1)/boards/shields/split_ortho4x6/Kconfig.shield
```kconfig
config SHIELD_SPLIT_ORTHO4X6_LEFT
    def_bool $(shields_list_contains,split_ortho4x6_left)
config SHIELD_SPLIT_ORTHO4X6_RIGHT
    def_bool $(shields_list_contains,split_ortho4x6_right)
```
